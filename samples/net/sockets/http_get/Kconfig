## samples/net/sockets/http_get/Kconfig
```kconfig
#
# Copyright (c) 2025 Ezurio
#
# SPDX-License-Identifier: Apache-2.0
#

source "samples/net/common/Kconfig"
source "Kconfig.zephyr"

module = APP
module-str = APP
source "subsys/logging/Kconfig.template.log_config"
```

## samples/net/sockets/http_get/boards/frdm_mcxn947_mcxn947_cpu0.conf
```kconfig
# (C) Copyright 2025, SECO Mind Srl
#
# SPDX-License-Identifier: Apache-2.0

CONFIG_DNS_SERVER1="8.8.8.8"

CONFIG_NET_DHCPV4=y

# Disable unneeded settings from the base prj.conf:
CONFIG_NET_CONFIG_SETTINGS=n
CONFIG_NET_CONFIG_NEED_IPV4=n
CONFIG_NET_CONFIG_MY_IPV4_ADDR=""
CONFIG_NET_CONFIG_MY_IPV4_GW=""
CONFIG_NET_CONFIG_PEER_IPV4_ADDR=""

# Large log buffer
CONFIG_LOG_BUFFER_SIZE=32768
```

## samples/subsys/uuid/sample.yaml
```yaml
sample:
  name: UUID

tests:
  sample.subsys.uuid:
    tags: uuid
    timeout: 10
    platform_allow:
      - qemu_x86
      - native_sim
      - native_sim/native/64
    integration_platforms:
      - native_sim
    filter: CONFIG_ENTROPY_HAS_DRIVER
```
